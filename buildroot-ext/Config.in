## buildroot-ext/Config.in
```kconfig
menu "TestSoc Options"
  source "$BR2_EXTERNAL_TESTSOC_PATH/package/microork/Config.in"
endmenu
```

## buildroot-ext/configs/testsoc_defconfig
```kconfig
#
# Target options
#
BR2_riscv=y
BR2_RISCV_32=y

#
# Instruction Set Extensions
#
BR2_riscv_custom=y
BR2_RISCV_ISA_CUSTOM_RVM=y
BR2_RISCV_ISA_CUSTOM_RVA=y
BR2_RISCV_ISA_CUSTOM_RVC=n
BR2_RISCV_ABI_ILP32=y

BR2_GLOBAL_PATCH_DIR="$$(BR2_EXTERNAL_TESTSOC_PATH)/board/testsoc/patches"

# GCC
BR2_GCC_VERSION_8_X=y
BR2_GCC_VERSION="8.3.0"
BR2_TOOLCHAIN_BUILDROOT_CXX=y
BR2_PACKAGE_GDB_NEEDS_CXX11=y
BR2_PACKAGE_GDB=y
BR2_PACKAGE_GDB_DEBUGGER=y
BR2_PACKAGE_GDB_ARCH_SUPPORTS=y
BR2_PACKAGE_GDB_TUI=y

# System
BR2_TARGET_GENERIC_GETTY=y
BR2_TARGET_GENERIC_GETTY_PORT="hvc0"

# Filesystem
BR2_TARGET_ROOTFS_CPIO=y
BR2_TARGET_ROOTFS_CPIO_GZIP=y

# Kernel
BR2_PACKAGE_HOST_LINUX_HEADERS_CUSTOM_5_0=y
BR2_LINUX_KERNEL=y
BR2_LINUX_KERNEL_CUSTOM_VERSION=y
BR2_LINUX_KERNEL_CUSTOM_VERSION_VALUE="5.0.13"
BR2_LINUX_KERNEL_USE_CUSTOM_CONFIG=y
BR2_LINUX_KERNEL_CUSTOM_CONFIG_FILE="$$(BR2_EXTERNAL_TESTSOC_PATH)/board/testsoc/linux.config"
BR2_LINUX_KERNEL_IMAGE=y

# rootfs customisation
BR2_ROOTFS_OVERLAY="$$(BR2_EXTERNAL_TESTSOC_PATH)/board/testsoc/rootfs_overlay"

# TOZ
BR2_PACKAGE_LIBSTDCPP=y
BR2_PACKAGE_LIBCURL=y
BR2_PACKAGE_RAPIDJSON=y
#BR2_TOOLCHAIN_HAS_ATOMIC
#BR2_TOOLCHAIN_HAS_THREADS
BR2_PACKAGE_ZEROMQ=y
BR2_PACKAGE_CPPZMQ=y
BR2_PACKAGE_MICROORK=y

# Extra packages
BR2_PACKAGE_DROPBEAR=y
BR2_PACKAGE_NFS_UTILS=y

BR2_PACKAGE_IPERF3=y
BR2_PACKAGE_RAMSPEED=y
BR2_PACKAGE_STRACE=y
BR2_PACKAGE_DHRYSTONE=y
BR2_PACKAGE_WHETSTONE=y

BR2_TARGET_GENERIC_ISSUE="Welcome to the Machine, yo.."
BR2_TARGET_GENERIC_HOSTNAME="testsoc"
BR2_TARGET_GENERIC_ROOT_PASSWD="$SOCPASSWORD"

#BR2_PACKAGE_BINUTILS=y
#BR2_PACKAGE_BINUTILS_TARGET=y
#BR2_PACKAGE_GIT=y
#BR2_PACKAGE_MAKE=y
#BR2_PACKAGE_PKGCONF=y
#BR2_PACKAGE_SSHFS=y
#BR2_PACKAGE_LIBFUSE=y
#BR2_PACKAGE_DHRYSTONE=y
#BR2_PACKAGE_MICROPYTHON=y
```

## buildroot-ext/package/microork/Config.in
```kconfig
config BR2_PACKAGE_MICROORK
	bool "microork"
	depends on BR2_INSTALL_LIBSTDCPP
	depends on BR2_PACKAGE_LIBCURL
	depends on BR2_PACKAGE_RAPIDJSON
	depends on BR2_TOOLCHAIN_HAS_ATOMIC
	depends on BR2_TOOLCHAIN_HAS_THREADS
	depends on !BR2_STATIC_LIBS
	help
	  microork yo

	  https://github.com/tweakoz/micro_ork

comment "microork needs a toolchain w/ C++, shared libraries, libatomic, pthreads, rapidjson, and libcurl"

config BR2_PACKAGE_MICROORK_WHATUPYO
	string "whatupyo"
	help
	  what up yo
```
